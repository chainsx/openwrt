// SPDX-License-Identifier: (GPL-2.0+ OR MIT)
/*
 * FriendlyElec NanoPC-T4 board device tree source
 *
 * Copyright (c) 2020 FriendlyElec Computer Tech. Co., Ltd.
 * (http://www.friendlyarm.com)
 *
 * Copyright (c) 2018 Collabora Ltd.
 *
 * Copyright (c) 2020 Jensen Huang <jensenhuang@friendlyarm.com>
 */

/dts-v1/;
#include "rk3399-nanopi-r4s.dts"

/ {
	model = "FriendlyElec NanoPi R4SE";
	compatible = "friendlyarm,nanopi-r4se", "rockchip,rk3399";
};

&emmc_phy {
	status = "okay";
};

&sdhci {
	bus-width = <8>;
	non-removable;
	status = "okay";
};
&sdmmc {
 pinctrl-0 = <&sdmmc_cd>;
};
