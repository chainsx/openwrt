## target/linux/embfly/files/bsp/drivers/can/Kconfig
```kconfig
# SPDX-License-Identifier: GPL-2.0-only

menu "CAN Drivers"
	depends on AW_BSP

config AW_CAN_SUN55I
	depends on CAN
	tristate "Allwinner SUN55I T536 CAN controller"
	default n
	help
	  if say Y here, you can use T536 CAN controller.

endmenu
```

## target/linux/embfly/files/bsp/drivers/net/wireless/rtl8189fs/Kconfig
```kconfig
config RTL8189FS
    tristate "Realtek 8189F SDIO WiFi V5.15.10"
    depends on MMC
    help
        Help message of RTL8189FS
```

## target/linux/embfly/files/bsp/drivers/tvin/hrc/Kconfig
```kconfig
# SPDX-License-Identifier: GPL-2.0

menu "HRC Driver"
	depends on AW_BSP

config AW_HRC
	tristate "HRC Support for Allwinner SoCs"
	default n
	select MEDIA_SUPPORT
	select VIDEOBUF2_DMA_CONTIG
	help
	  Support for sunxi platform HDMI Rx Capture engine,
	  this module is used to capture HDMI RX images to DDR
	  for image display or other image processing work.

	  To compile this driver as a module, choose M here.
	  If you are not sure whether the platform supports it, choose N here.

endmenu
```

## target/linux/embfly/files/bsp/drivers/usb/gadget/function/Kconfig
```kconfig
# SPDX-License-Identifier: GPL-2.0-only

if USB_GADGET

config USB_SUNXI_CONFIGFS_F_HID
	tristate "Allwinner HID function"
        depends on USB_SUNXI_GADGET
	depends on USB_CONFIGFS
	select USB_F_HID
	help
	  The HID function driver provides generic emulation of USB
	  Human Interface Devices (HID).

	  For more information, see Documentation/usb/gadget_hid.rst.

config USB_SUNXI_F_UVC
	tristate

config USB_SUNXI_CONFIGFS_F_UVC
	tristate "Allwinner USB Webcam function"
	depends on USB_SUNXI_GADGET
	depends on USB_CONFIGFS
	depends on VIDEO_V4L2
	depends on VIDEO_DEV
	select VIDEOBUF2_VMALLOC
	select USB_SUNXI_F_UVC
	help
	  The Webcam function acts as a composite USB Audio and Video Class
	  device. It provides a userspace API to process UVC control requests
	  and stream video data to the host.

endif # USB_GADGET
```

## target/linux/embfly/files/bsp/platform/Kconfig.turbo
```kconfig
# SPDX-License-Identifier: GPL-2.0-only
menu "Allwinner's Turbo Options"
	depends on AW_BSP

config AW_BSP_LOWMEM
	bool "Lowmem config in tiny memory platform"
	default n
	depends on AW_BSP

endmenu
```

## target/linux/embfly/image/Config.in
```kconfig
config TARGET_KERNEL_PARTSIZE
	int "Boot (SD Card) filesystem partition size (in MB)"
	depends on TARGET_embfly
	default 32
```
