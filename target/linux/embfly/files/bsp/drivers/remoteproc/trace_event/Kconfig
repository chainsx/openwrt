## target/linux/embfly/files/bsp/drivers/remoteproc/trace_event/Kconfig
```kconfig
menuconfig COMPONENTS_EVENTS
	bool "RTOS Event Support"
	default n
	help
	  RTOS Event Support.

if COMPONENTS_EVENTS
config MAX_EVENT_BUFFER_SIZE
	int "Max Event Buffer Size(Kb)"
	default 32

config MAX_TASK_NAME_CNT
	int "max record task name"
	default 32

config MAX_TASK_NAME_LEN
	int "max record task name len"
	default 32

choice
	prompt "print timestamp formet"
	default EVENTS_PRINT_TIME_FMT_FLOAT
config EVENTS_PRINT_TIME_FMT_LONG
	bool "print timestamp with %ld"
config EVENTS_PRINT_TIME_FMT_FLOAT
	bool "print timestamp with %0.6f"
config EVENTS_PRINT_TIME_FMT_DOUBLE
	bool "print timestamp with %0.6lf"
endchoice

source "components/common/aw/trace_event/event.Kconfig"

endif # if COMPONENTS_EVENTS
```
